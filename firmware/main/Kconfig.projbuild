## firmware/main/Kconfig.projbuild
```kconfig
menu "BLE test instrumentation"
config BLE_TEST_DIAGNOSTICS
    bool "Read-only bounded BLE diagnostic characteristic (test builds only)"
    default n
    help
        Adds c0de0005 and queue timestamps/counters. Does not change the
        fixed 20-byte v1 protocol. Disable for normal production builds.
config BLE_EVENT_SCHEDULER
    bool "Experimental event/resource notify scheduler"
    depends on BLE_TEST_DIAGNOSTICS
    default n
    help
        Bench A/B only. The 12/24/36 pool candidates still failed overloaded
        control deadlines; keep the previous scheduler as the normal fallback.
config BLE_CONNECTION_POLICY
    int "Test connection profile (0=default, 1=15-30ms, 2=7.5-15ms)"
    depends on BLE_TEST_DIAGNOSTICS
    range 0 2
    default 0
    help
        Observe the central first, then request once after subscription.
        Only immediate local rejection permits one retry. No PHY/MTU changes.
        Keep disabled normally: overload ingress accounting remains unresolved.
endmenu

menu "CAN analyzer status LED"
config CAN_STATUS_LED
    bool "GPIO3 communication indicator (active high)"
    depends on IDF_TARGET_ESP32S3
    default y
    help
        Use the separate GPIO3 LED even when the local panel is disabled.
        Off without a wireless client/peer, steady on when connected, and
        short off pulses on successful CAN RX/TX (at most five per second).
endmenu

menu "CAN analyzer local panel"
config CAN_LOCAL_PANEL
    bool "ST7789 screen, buttons, backlight and buzzer"
    depends on IDF_TARGET_ESP32S3
    default y
config CAN_LCD_X_GAP
    int "ST7789 column offset"
    depends on CAN_LOCAL_PANEL
    range 0 68
    default 34
config CAN_LCD_Y_GAP
    int "ST7789 row offset"
    depends on CAN_LOCAL_PANEL
    range 0 0
    default 0
config CAN_LCD_INVERT
    bool "Invert panel colors (typical IPS panel)"
    depends on CAN_LOCAL_PANEL
    default y
config CAN_LCD_BGR
    bool "Use BGR instead of RGB color order"
    depends on CAN_LOCAL_PANEL
    default n
endmenu
```

## firmware/sdkconfig.defaults
```kconfig
CONFIG_BT_ENABLED=y
CONFIG_BT_BLUEDROID_ENABLED=n
CONFIG_BT_NIMBLE_ENABLED=y
CONFIG_BT_NIMBLE_MAX_CONNECTIONS=1
CONFIG_BT_NIMBLE_LOG_LEVEL_NONE=y
CONFIG_ESPTOOLPY_FLASHSIZE_4MB=y
CONFIG_BOOTLOADER_LOG_LEVEL_NONE=y
CONFIG_LOG_DEFAULT_LEVEL_NONE=y
CONFIG_LOG_MAXIMUM_EQUALS_DEFAULT=y
CONFIG_LOG_TAG_LEVEL_IMPL_NONE=y
CONFIG_LOG_DYNAMIC_LEVEL_CONTROL=n

CONFIG_BT_NIMBLE_SECURITY_ENABLE=y
CONFIG_ESP_COEX_SW_COEXIST_ENABLE=y
CONFIG_MBEDTLS_PEM_WRITE_C=y
CONFIG_MBEDTLS_PK_WRITE_C=y
CONFIG_MBEDTLS_TLS_SERVER_AND_CLIENT=y
CONFIG_MBEDTLS_X509_CREATE_C=y
CONFIG_MBEDTLS_X509_CRT_WRITE_C=y
CONFIG_BT_NIMBLE_SM_SC=y
CONFIG_BT_NIMBLE_SM_LEGACY=n
CONFIG_BT_NIMBLE_SM_SC_ONLY=1
CONFIG_BT_NIMBLE_LL_CFG_FEAT_LE_ENCRYPTION=y
CONFIG_BT_NIMBLE_NVS_PERSIST=y
CONFIG_PARTITION_TABLE_SINGLE_APP=n
CONFIG_PARTITION_TABLE_CUSTOM=y
CONFIG_PARTITION_TABLE_CUSTOM_FILENAME="partitions.csv"
CONFIG_BT_NIMBLE_HOST_TASK_STACK_SIZE=8192
```

## firmware/sdkconfig.defaults.esp32s3
```kconfig
CONFIG_ESP_CONSOLE_NONE=y
# CONFIG_ESP_CONSOLE_USB_SERIAL_JTAG is not set
CONFIG_ESP_CONSOLE_SECONDARY_NONE=y
CONFIG_ESP_DEFAULT_CPU_FREQ_MHZ_240=y
CONFIG_SPIRAM=n
CONFIG_ESPTOOLPY_FLASHFREQ_40M=y
```

## firmware/tests/wifi_txtest/sdkconfig.defaults
```kconfig
CONFIG_IDF_TARGET="esp32s3"
CONFIG_ESPTOOLPY_FLASHMODE_DIO=y
CONFIG_ESPTOOLPY_FLASHFREQ_40M=y
CONFIG_ESPTOOLPY_FLASHSIZE_4MB=y
CONFIG_PARTITION_TABLE_CUSTOM=y
CONFIG_PARTITION_TABLE_CUSTOM_FILENAME="../../partitions.csv"
CONFIG_PARTITION_TABLE_OFFSET=0x8000
CONFIG_PARTITION_TABLE_MD5=y
CONFIG_ESP_CONSOLE_USB_SERIAL_JTAG=y
CONFIG_ESP_CONSOLE_SECONDARY_NONE=y
CONFIG_LOG_DEFAULT_LEVEL_INFO=y
CONFIG_LOG_MAXIMUM_EQUALS_DEFAULT=y
CONFIG_ESP_WIFI_NVS_ENABLED=n
CONFIG_ESP_PHY_CALIBRATION_AND_DATA_STORAGE=n
CONFIG_ESP_PHY_INIT_DATA_IN_PARTITION=n
CONFIG_ESP_PHY_MAX_WIFI_TX_POWER=20
CONFIG_ESP_DEFAULT_CPU_FREQ_MHZ_240=y
CONFIG_SPIRAM=n
```
